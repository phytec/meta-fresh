## conf/distro/ampliphy-4.19.y-barebox-master.conf
```bitbake
require conf/distro/ampliphy.conf

PREFERRED_VERSION_linux-mainline = "4.19.y-phy%"
PREFERRED_VERSION_barebox = "master"
```

## conf/distro/ampliphy-5.10.y-phynext.conf
```bitbake
require conf/distro/ampliphy.conf

PREFERRED_VERSION_linux-mainline = "5.10.y-phy%"
SRC_URI_pn-linux-mainline = "git://git@git.phytec.de/linux-mainline-dev;protocol=ssh;branch=v5.10.y-phynext"
SRCREV_pn-linux-mainline = "${AUTOREV}"
```

## conf/distro/ampliphy-5.10.y.conf
```bitbake
require conf/distro/ampliphy.conf

PREFERRED_VERSION_linux-mainline = "5.10.y-phy%"
```

## conf/distro/ampliphy-5.15.y-barebox-master.conf
```bitbake
require conf/distro/ampliphy.conf

PREFERRED_VERSION_linux-mainline = "5.15.y-phy%"
PREFERRED_VERSION_barebox = "master"
```

## conf/distro/ampliphy-5.15.y-phynext.conf
```bitbake
require conf/distro/ampliphy.conf

PREFERRED_VERSION_linux-mainline = "5.15.y-phy%"
SRC_URI_pn-linux-mainline = "git://git@git.phytec.de/linux-mainline-dev;protocol=ssh;branch=v5.15.y-phynext"
SRCREV_pn-linux-mainline = "${AUTOREV}"
```

## conf/distro/ampliphy-5.15.y.conf
```bitbake
require conf/distro/ampliphy.conf

PREFERRED_VERSION_linux-mainline = "5.15.y-phy%"
```

## conf/distro/ampliphy-5.4.y-phynext.conf
```bitbake
require conf/distro/ampliphy.conf

PREFERRED_VERSION_linux-mainline = "5.4.y-phy%"
SRC_URI:pn-linux-mainline = "git://git@git.phytec.de/linux-mainline-dev;protocol=ssh;branch=v5.4.y-phynext"
SRCREV:pn-linux-mainline = "${AUTOREV}"
```

## conf/distro/ampliphy-5.4.y.conf
```bitbake
require conf/distro/ampliphy.conf

PREFERRED_VERSION_linux-mainline = "5.4.y-phy%"
```

## conf/distro/ampliphy-6.6.y.conf
```bitbake
require conf/distro/ampliphy.conf

PREFERRED_VERSION_linux-phytec = "6.6.y-phy%"
```

## conf/distro/ampliphy-vanilla-master-u-boot-master.conf
```bitbake
require conf/distro/ampliphy.conf

PREFERRED_PROVIDER_virtual/kernel = "linux-vanilla"
PREFERRED_VERSION_linux-vanilla = "master"
PREFERRED_PROVIDER_virtual/bootloader = "u-boot"
PREFERRED_VERSION_virtual/bootloader = "master"

# map the KERNEL_DEVICETREE with the upstream dts names
KERNEL_DEVICETREE:phyboard-polis-imx8mm-5 = "freescale/imx8mm-phyboard-polis-rdk.dtb"
KERNEL_DEVICETREE:phyboard-pollux-imx8mp-3 = "freescale/imx8mp-phyboard-pollux-rdk.dtb"
KERNEL_DEVICETREE:phygate-tauri-l-imx8mm-2 = "freescale/imx8mm-phygate-tauri-l.dtb"
```

## conf/distro/ampliphy-vanilla-master.conf
```bitbake
require conf/distro/ampliphy.conf

PREFERRED_PROVIDER_virtual/kernel = "linux-vanilla"
PREFERRED_VERSION_linux-vanilla = "master"

# map the KERNEL_DEVICETREE with the upstream dts names
KERNEL_DEVICETREE:phyboard-mira-imx6-3 = "imx6q-phytec-mira-rdk-nand.dtb"
KERNEL_DEVICETREE:phyboard-mira-imx6-5 = "imx6q-phytec-mira-rdk-emmc.dtb"
KERNEL_DEVICETREE:phyboard-mira-imx6-8 = "imx6q-phytec-mira-rdk-emmc.dtb"
KERNEL_DEVICETREE:phyboard-mira-imx6-9 = "imx6qp-phytec-mira-rdk-nand.dtb"
KERNEL_DEVICETREE:phyboard-mira-imx6-10 = "imx6q-phytec-mira-rdk-nand.dtb"
KERNEL_DEVICETREE:phyboard-mira-imx6-11 = "imx6q-phytec-mira-rdk-nand.dtb"
KERNEL_DEVICETREE:phyboard-mira-imx6-13 = "imx6q-phytec-mira-rdk-nand.dtb"
KERNEL_DEVICETREE:phyboard-mira-imx6-15 = "imx6dl-phytec-mira-rdk-nand.dtb"
```

## conf/distro/yogurt-5.10.y-barebox-master.conf
```bitbake
require conf/distro/yogurt.conf

PREFERRED_VERSION_linux-mainline = "5.10.y-phy%"
PREFERRED_VERSION_barebox = "master"
```

## conf/distro/yogurt-5.10.y.conf
```bitbake
require conf/distro/yogurt.conf

PREFERRED_VERSION_linux-mainline = "5.10.y-phy%"
```

## conf/distro/yogurt_4.19.y.conf
```bitbake
require conf/distro/yogurt.conf

PREFERRED_VERSION_linux-mainline = "4.19.y-phy%"
PREFERRED_VERSION_barebox = "master"
```

## conf/distro/yogurt_5.4.y.conf
```bitbake
require conf/distro/yogurt.conf

PREFERRED_VERSION_linux-mainline = "5.4.y-phy%"
```

## conf/distro/yogurt_vanilla_master.conf
```bitbake
require conf/distro/yogurt.conf

PREFERRED_PROVIDER_virtual/kernel = "linux-vanilla"
PREFERRED_VERSION_linux-vanilla = "master"
```

## conf/layer.conf
```bitbake
# We have a conf and classes directory, add to BBPATH
BBPATH .= ":${LAYERDIR}"

# We have recipes-* directories, add to BBFILES
BBFILES += "${LAYERDIR}/recipes-*/*/*.bb \
            ${LAYERDIR}/recipes-*/*/*.bbappend"

BBFILE_COLLECTIONS += "meta-fresh"
BBFILE_PATTERN_meta-fresh = "^${LAYERDIR}/"
BBFILE_PRIORITY_meta-fresh = "10"

LAYERDEPENDS_meta-fresh = "phytec ampliphy"
LAYERSERIES_COMPAT_meta-fresh = "honister kirkstone langdale mickledore nanbield"
```
